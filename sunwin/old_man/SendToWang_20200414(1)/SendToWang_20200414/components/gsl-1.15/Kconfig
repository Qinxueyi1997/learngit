## sunwin/old_man/SendToWang_20200414(1)/SendToWang_20200414/components/gsl-1.15/Kconfig
```kconfig
menu "GLS"

    config GLS_ENABLE
        bool "Enable GLS"
        default "y"
        help
            GLS lib by ahu university.

endmenu
```

## sunwin/old_man/process/SendToWang_20200414(1)/SendToWang_20200414/components/sleep_monitoring/Kconfig
```kconfig
menu "SleepMonUtils"

    config SLEEPMON_ENABLE
        bool "Enable SleepMonitoring"
        default "y"
        help
            Sleep monitoring by ahu university.

endmenu
```
